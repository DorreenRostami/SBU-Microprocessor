;Clock 
RCC_AHB1ENR  	EQU 0x40023830

;GPIOA
; Base Adr = 0x400200
GPIOA_MODER 	EQU 0x40020000
GPIOA_IDR    	EQU 0x40020010
GPIOA_ODR	 	EQU 0x40020014


;GPIOB
; Base Adr = 0x40020400
GPIOB_MODER		EQU 0x40020400
GPIOB_IDR    	EQU 0x40020410
GPIOB_ODR	 	EQU 0x40020414


;RN directives
CURR_LED		RN 	R8
CURR_FLOOR 		RN 	R9
DEST_FLOOR 		RN 	R10
VAL1_ENTERED 	RN 	R11
VAL2_ENTERED 	RN 	R12


	EXPORT SystemInit
	EXPORT __main		
	
	AREA Mycode , CODE , READONLY

SystemInit FUNCTION
	
	;ENABLE CLK PA PB
	LDR R1 , =RCC_AHB1ENR
	MOV R0 , #0x03  ; 0000..0011 -> enable clock for B and A
	STR R0 , [R1]
	
	;GPIOA MODER = OUTPUT PIN 0-15
	LDR R1 , =GPIOA_MODER
	LDR R0 , [R1]
	MOV R0 , #0x55555555 ;01010101...01
	STR R0 , [R1]
	
	;GPIOB MODER 
	LDR R1 , =GPIOB_MODER
	LDR R0 , [R1]
	LDR R0 , =0x55000055 ;0101010100...0001010101
	STR R0 , [R1]
	
	MOV VAL1_ENTERED, #0
	MOV VAL2_ENTERED, #0
	MOV CURR_FLOOR, #0xF
	MOV DEST_FLOOR, #0xF
	MOV CURR_LED, #2
	
	ENDFUNC


__main FUNCTION	
	LDR  R1 , =GPIOA_ODR
	MOV  R0 , #0x0000
	STR  R0 , [R1]
		
LOOP	
	LDR R2 , =GPIOB_IDR
	LDR R0 , [R2]
	
	MOV R4 , #0xFF7F ;value for button: 1111 1111 0111 1111
	ORR R0 , R0 , R4
	CMP R0 , R4
	BNE CHECK_KEYPAD
	MOV VAL2_ENTERED, #0
	MOV VAL1_ENTERED, #0
	MOV CURR_FLOOR, #0xF
	MOV DEST_FLOOR, #0xF
	MOV CURR_LED, #2
	LDR R1, =GPIOA_ODR
	MOV R0, #0x0000
	STR R0, [R1]
	B LOOP

CHECK_KEYPAD
	CMP VAL2_ENTERED, #1
	BEQ.W MOVE

	;FIRST ROW KP ENABLE
	LDR R2 , =GPIOB_ODR
	MOV R3 , #0xEFF8
	STR R3 , [R2]
	
	;check if 1 is pressed	
	MOV R4 , #0xFEFF ;value for key 1: 1111 1110 1111 1111 -> kp1: 0
	LDR R2 , =GPIOB_IDR
	LDR R0 , [R2]
	ORR R0 , R0 , R4
	CMP R0 , R4
	BNE CHECK_TWO
	CMP CURR_FLOOR, #1
	BEQ LOOP
	CMP VAL1_ENTERED, #1
	MOVEQ DEST_FLOOR, #1
	MOVEQ VAL2_ENTERED, #1
	BEQ LOOP
	MOV VAL1_ENTERED, #1
	MOV CURR_FLOOR, #1
	LDR R1, =GPIOA_ODR
	MOV R0, #0x1000
	STR R0, [R1]
	B LOOP

CHECK_TWO
	;check if 2 is pressed
	MOV R4 , #0xFDFF ;value for key 2: 1111 1101 1111 1111 -> kp2: 0
	LDR R2 , =GPIOB_IDR
	LDR R0 , [R2]
	ORR R0 , R0 , R4
	CMP R0 , R4	
	BNE CHECK_THREE
	CMP CURR_FLOOR, #2
	BEQ LOOP
	CMP VAL1_ENTERED, #1
	MOVEQ DEST_FLOOR, #2
	MOVEQ VAL2_ENTERED, #1
	BEQ LOOP
	MOV VAL1_ENTERED, #1
	MOV CURR_FLOOR, #2
	LDR R1, =GPIOA_ODR
	MOV R0, #0x2000
	STR R0, [R1]
	B LOOP

CHECK_THREE
	;check if 3 is pressed
	MOV R4 , #0xFBFF ;value for key 3: 1111 1011 1111 1111 -> kp3: 0
	LDR R2 , =GPIOB_IDR
	LDR R0 , [R2]
	ORR R0 , R0 , R4
	CMP R0 , R4	
	BNE ENABLE_SECOND_ROW
	CMP CURR_FLOOR, #3
	BEQ LOOP
	CMP VAL1_ENTERED, #1
	MOVEQ DEST_FLOOR, #3
	MOVEQ VAL2_ENTERED, #1
	BEQ LOOP
	MOV VAL1_ENTERED, #1
	MOV CURR_FLOOR, #3
	LDR R1, =GPIOA_ODR
	MOV R0, #0x3000
	STR R0, [R1]
	B LOOP
	
ENABLE_SECOND_ROW	
	;SECOND ROW KP ENABLE
	LDR R2 , =GPIOB_ODR
	MOV R3 , #0xDFF8
	STR R3 , [R2]
	
	;check if 4 is pressed	
	MOV R4 , #0xFEFF ;value for key 4: 1111 1110 1111 1111 -> kp1: 0
	LDR R2 , =GPIOB_IDR
	LDR R0 , [R2]
	ORR R0 , R0 , R4
	CMP R0 , R4
	BNE CHECK_FIVE
	CMP CURR_FLOOR, #4
	BEQ LOOP
	CMP VAL1_ENTERED, #1
	MOVEQ DEST_FLOOR, #4
	MOVEQ VAL2_ENTERED, #1
	BEQ LOOP
	MOV VAL1_ENTERED, #1
	MOV CURR_FLOOR, #4
	LDR R1, =GPIOA_ODR
	MOV R0, #0x4000
	STR R0, [R1]
	B LOOP

CHECK_FIVE
	;check if 5 is pressed
	MOV R4 , #0xFDFF ;value for key 5: 1111 1101 1111 1111 -> kp2: 0
	LDR R2 , =GPIOB_IDR
	LDR R0 , [R2]
	ORR R0 , R0 , R4
	CMP R0 , R4	
	BNE CHECK_SIX
	CMP CURR_FLOOR, #5
	BEQ LOOP
	CMP VAL1_ENTERED, #1
	MOVEQ DEST_FLOOR, #5
	MOVEQ VAL2_ENTERED, #1
	BEQ LOOP
	MOV VAL1_ENTERED, #1
	MOV CURR_FLOOR, #5
	LDR R1, =GPIOA_ODR
	MOV R0, #0x5000
	STR R0, [R1]
	B LOOP

CHECK_SIX
	;check if 6 is pressed
	MOV R4 , #0xFBFF ;value for key 6: 1111 1011 1111 1111 -> kp3: 0
	LDR R2 , =GPIOB_IDR
	LDR R0 , [R2]
	ORR R0 , R0 , R4
	CMP R0 , R4	
	BNE ENABLE_THIRD_ROW
	CMP CURR_FLOOR, #6
	BEQ LOOP
	CMP VAL1_ENTERED, #1
	MOVEQ DEST_FLOOR, #6
	MOVEQ VAL2_ENTERED, #1
	BEQ LOOP
	MOV VAL1_ENTERED, #1
	MOV CURR_FLOOR, #6
	LDR R1, =GPIOA_ODR
	MOV R0, #0x6000
	STR R0, [R1]
	B LOOP

ENABLE_THIRD_ROW
	;THIRD ROW KP ENABLE
	LDR R2 , =GPIOB_ODR
	MOV R3 , #0xBFF8
	STR R3 , [R2]
	
	;check if 7 is pressed	
	MOV R4 , #0xFEFF ;value for key 7: 1111 1110 1111 1111 -> kp1: 0
	LDR R2 , =GPIOB_IDR
	LDR R0 , [R2]
	ORR R0 , R0 , R4
	CMP R0 , R4
	BNE CHECK_EIGHT
	CMP CURR_FLOOR, #7
	BEQ LOOP
	CMP VAL1_ENTERED, #1
	MOVEQ DEST_FLOOR, #7
	MOVEQ VAL2_ENTERED, #1
	BEQ LOOP
	MOV VAL1_ENTERED, #1
	MOV CURR_FLOOR, #7
	LDR R1, =GPIOA_ODR
	MOV R0, #0x7000
	STR R0, [R1]
	B LOOP

CHECK_EIGHT
	;check if 8 is pressed
	MOV R4 , #0xFDFF ;value for key 8: 1111 1101 1111 1111 -> kp2: 0
	LDR R2 , =GPIOB_IDR
	LDR R0 , [R2]
	ORR R0 , R0 , R4
	CMP R0 , R4	
	BNE CHECK_NINE
	CMP CURR_FLOOR, #8
	BEQ LOOP
	CMP VAL1_ENTERED, #1
	MOVEQ DEST_FLOOR, #8
	MOVEQ VAL2_ENTERED, #1
	BEQ LOOP
	MOV VAL1_ENTERED, #1
	MOV CURR_FLOOR, #8
	LDR R1, =GPIOA_ODR
	MOV R0, #0x8000
	STR R0, [R1]
	B LOOP

CHECK_NINE
	;check if 9 is pressed
	MOV R4 , #0xFBFF ;value for key 9: 1111 1011 1111 1111 -> kp3: 0
	LDR R2 , =GPIOB_IDR
	LDR R0 , [R2]
	ORR R0 , R0 , R4
	CMP R0 , R4	
	BNE ENABLE_FOURTH_ROW
	CMP CURR_FLOOR, #9
	BEQ LOOP
	CMP VAL1_ENTERED, #1
	MOVEQ DEST_FLOOR, #9
	MOVEQ VAL2_ENTERED, #1
	BEQ LOOP
	MOV VAL1_ENTERED, #1
	MOV CURR_FLOOR, #9
	LDR R1, =GPIOA_ODR
	MOV R0, #0x9000
	STR R0, [R1]
	B LOOP

ENABLE_FOURTH_ROW
	;FOURTH ROW KP ENABLE
	LDR R2 , =GPIOB_ODR
	MOV R3 , #0x7FF8
	STR R3 , [R2]
	
	;check if 0 is pressed
	MOV R4 , #0xFDFF ;value for key 0: 1111 1101 1111 1111 -> kp2: 0
	LDR R2 , =GPIOB_IDR
	LDR R0 , [R2]
	ORR R0 , R0 , R4
	CMP R0 , R4	
	BNE LOOP
	CMP CURR_FLOOR, #0
	BEQ LOOP
	CMP VAL1_ENTERED, #1
	MOVEQ DEST_FLOOR, #0
	MOVEQ VAL2_ENTERED, #1
	BEQ LOOP
	MOV VAL1_ENTERED, #1
	MOV CURR_FLOOR, #0
	LDR R1, =GPIOA_ODR
	MOV R0, #0x0000
	STR R0, [R1]		
	B LOOP		

MOVE
	CMP CURR_FLOOR, DEST_FLOOR
	BEQ LOOP
	LDR R0, =2000000
DELAY_LOOP
	CMP R0, #0
	BEQ DONE_DELAY
	SUB R0, R0, #1
	B DELAY_LOOP
DONE_DELAY	
	CMP CURR_FLOOR, DEST_FLOOR
	BCS MOVE_DOWN ;if curr < dest
	ADD CURR_FLOOR, CURR_FLOOR, #1
	B SHOW_FLOOR
MOVE_DOWN
	SUB CURR_FLOOR, CURR_FLOOR, #1
SHOW_FLOOR
	CMP CURR_LED, #3
	BNE LED_2
	LSL R2, CURR_FLOOR, #12
	LDR R1, =GPIOA_ODR
	MOV R0, R2
	STR R0, [R1]
	LDR R2 , =GPIOB_ODR
	MOV R3 , #0xFFF8
	STR R3 , [R2]
	SUB CURR_LED, CURR_LED, #1
	B LOOP
LED_2
	CMP CURR_LED, #2
	BNE LED_1
	LSL R2, CURR_FLOOR, #8
	LDR R1, =GPIOA_ODR
	LDR R0, [R1]
	ORR R0, R0, R2
	STR R0, [R1]
	LDR R2 , =GPIOB_ODR
	MOV R3 , #0xFFF4
	STR R3 , [R2]
	SUB CURR_LED, CURR_LED, #1
	B LOOP
LED_1
	CMP CURR_LED, #1
	BNE LED_0
	LSL R2, CURR_FLOOR, #4
	LDR R1, =GPIOA_ODR
	LDR R0, [R1]
	ORR R0, R0, R2
	STR R0, [R1]
	LDR R2 , =GPIOB_ODR
	MOV R3 , #0xFFF2
	STR R3 , [R2]
	SUB CURR_LED, CURR_LED, #1
	B LOOP
LED_0
	LDR R1, =GPIOA_ODR
	LDR R0, [R1]
	ORR R0, R0, CURR_FLOOR
	STR R0, [R1]
	LDR R2 , =GPIOB_ODR
	MOV R3 , #0xFFF1
	STR R3 , [R2]
	MOV CURR_LED, #3
	B LOOP
	
	ENDFUNC
	END